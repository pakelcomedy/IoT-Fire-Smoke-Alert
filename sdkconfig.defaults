## sdkconfig.defaults
```kconfig
#
# Default Wi‑Fi credentials
#
CONFIG_WIFI_SSID="YOUR_SSID"
CONFIG_WIFI_PASSWORD="YOUR_PASS"

#
# SPIFFS
#
CONFIG_SPIFFS_MAX_PARTITIONS=1
CONFIG_SPIFFS_FLASH_IN_PROJECT=y

#
# HTTP Server
#
CONFIG_HTTPD_DEFAULT_PORT=80

#
# ADC / Sensor
#
CONFIG_SENSOR_ADC_CHANNEL=6      # ADC1_CHANNEL_6 → GPIO34
CONFIG_SENSOR_THRESHOLD=2000

#
# Buzzer
#
CONFIG_BUZZER_GPIO=26
```
